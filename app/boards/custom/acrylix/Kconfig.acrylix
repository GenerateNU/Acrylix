## app/boards/custom/acrylix/Kconfig.acrylix
```kconfig
config BOARD_ACRYLIX
	select SOC_STM32F446XX
	select HAS_SEGGER_RTT if ZEPHYR_SEGGER_MODULE
```

## app/boards/custom/acrylix/Kconfig.defconfig
```kconfig
if BOARD_ACRYLIX

config HEAP_MEM_POOL_ADD_SIZE_BOARD
	int
	default 4096

endif # BOARD_ACRYLIX
```

## app/boards/custom/acrylix/board.yml
```yaml
board:
  name: acrylix
  full_name: AcrylicBender Custom PCB
  vendor: custom
  socs:
    - name: stm32f446xx
```
