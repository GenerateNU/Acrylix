## app/boards/custom/plaitpilot/board.yml
```yaml
# this file is just for your board in general, and doesnt provide any settings based on your specific board which is why we need a plaitpilot.yaml file. wtf
board:
  name: plaitpilot
  # name of directory that is holding this board
  vendor: custom
  # this is just names for any SoCs, not where the actual SoC selection occurs (happens in Kconfig)
  socs:
  - name: esp32
```

## app/boards/custom/plaitpilot/plaitpilot_procpu_defconfig
```kconfig
# default configurations for pre-existing kconfig symbols
# Basically what this means is for this custom board, when using only the propcpu within the esp32 (dualcore normally), you need these configurations for the board to work by default, hence "def" and "config".
CONFIG_MAIN_STACK_SIZE=2048
CONFIG_CLOCK_CONTROL=y 
CONFIG_SYS_CLOCK_EXISTS=y
CONFIG_SYS_CLOCK_HW_CYCLES_PER_SEC=80000000
CONFIG_CONSOLE=y
CONFIG_SERIAL=y
CONFIG_UART_CONSOLE=y
CONFIG_GPIO=y
```
